## sdkconfig.defaults
```kconfig
CONFIG_BLINK_LED_GPIO=y
CONFIG_BLINK_GPIO=8

# Enable FreeRTOS tick hook for automatic watchdog feeding
CONFIG_FREERTOS_USE_TICK_HOOK=y

# Watchdog configuration - generous timeout with automatic feeding
CONFIG_ESP_TASK_WDT_TIMEOUT_S=60
CONFIG_ESP_TASK_WDT_PANIC=n
```

## sdkconfig.defaults.esp32s3
```kconfig
CONFIG_BLINK_LED_STRIP=y
#
# Please Note:
# ESP32-S3-DevKitC v1.1 uses GPIO38 for the on-board LED
# ESP32-S3-DevKitC v1.0 uses GPIO48 for the on-board LED
#
CONFIG_BLINK_GPIO=38

#
# USB Serial/JTAG Configuration for Debugging
#
# Enable USB Serial/JTAG driver
CONFIG_USJ_ENABLE_USB_SERIAL_JTAG=y

# Use USB Serial/JTAG as primary console
CONFIG_ESP_CONSOLE_USB_SERIAL_JTAG=y
# CONFIG_ESP_CONSOLE_UART_DEFAULT is not set
# CONFIG_ESP_CONSOLE_USB_CDC is not set
CONFIG_ESP_CONSOLE_USB_SERIAL_JTAG_ENABLED=y

# Keep secondary output to UART for compatibility
CONFIG_ESP_CONSOLE_SECONDARY_NONE=y

# OpenOCD debugging support
# CONFIG_ESP_SYSTEM_DISABLE_JTAG is not set

# Application tracing via JTAG
CONFIG_APPTRACE_DEST_JTAG=y
CONFIG_APPTRACE_ENABLE=y
CONFIG_APPTRACE_LOCK_ENABLE=y

#
# FreeRTOS Configuration for uFlake Kernel
#
# Enable application tick hook for automatic watchdog feeding
CONFIG_FREERTOS_USE_TICK_HOOK=y

# Higher tick rate for better responsiveness (1000 Hz = 1ms precision)
CONFIG_FREERTOS_HZ=1000

# Task watchdog configuration
CONFIG_ESP_TASK_WDT=y
CONFIG_ESP_TASK_WDT_TIMEOUT_S=120
CONFIG_ESP_TASK_WDT_CHECK_IDLE_TASK_CPU0=n
CONFIG_ESP_TASK_WDT_CHECK_IDLE_TASK_CPU1=n

#
# ESP PSRAM Configuration for uFlake OS
#
CONFIG_SPIRAM=y

# Octal mode for best performance (ESP32-S3 supports this)
CONFIG_SPIRAM_MODE_OCT=y
# CONFIG_SPIRAM_MODE_QUAD is not set

# Auto-detect PSRAM type (recommended)
CONFIG_SPIRAM_TYPE_AUTO=y
# CONFIG_SPIRAM_TYPE_ESPPSRAM64 is not set

# PSRAM GPIO pins (standard ESP32-S3 pins)
CONFIG_SPIRAM_CLK_IO=30
CONFIG_SPIRAM_CS_IO=26

# 80MHz speed for optimal performance
CONFIG_SPIRAM_SPEED_80M=y
# CONFIG_SPIRAM_SPEED_40M is not set
CONFIG_SPIRAM_SPEED=80

# Boot-time configuration
CONFIG_SPIRAM_BOOT_HW_INIT=y
CONFIG_SPIRAM_BOOT_INIT=y
CONFIG_SPIRAM_PRE_CONFIGURE_MEMORY_PROTECTION=y
# CONFIG_SPIRAM_IGNORE_NOTFOUND is not set

# Use capabilities allocator (matches your memory_manager.c implementation)
CONFIG_SPIRAM_USE_CAPS_ALLOC=y
# CONFIG_SPIRAM_USE_MALLOC is not set
# CONFIG_SPIRAM_USE_MEMMAP is not set

# Enable memory test on boot
CONFIG_SPIRAM_MEMTEST=y

# Allow BSS segment in external memory (optional - good for large static arrays)
# CONFIG_SPIRAM_ALLOW_BSS_SEG_EXTERNAL_MEMORY is not set

# Allow stack in PSRAM (your config has this enabled)
CONFIG_SPIRAM_ALLOW_STACK_EXTERNAL_MEMORY=y

# Disable XIP features (not needed for your use case)
# CONFIG_SPIRAM_XIP_FROM_PSRAM is not set
# CONFIG_SPIRAM_FETCH_INSTRUCTIONS is not set
# CONFIG_SPIRAM_RODATA is not set

# Optional: WiFi/LWIP allocation in PSRAM (if you use WiFi)
# CONFIG_SPIRAM_TRY_ALLOCATE_WIFI_LWIP is not set

# Workarounds
CONFIG_ESP_SLEEP_PSRAM_LEAKAGE_WORKAROUND=y
CONFIG_STDATOMIC_S32C1I_SPIRAM_WORKAROUND=y

# ESP32-S3 specific
CONFIG_ESP32S3_SPIRAM_SUPPORT=y
CONFIG_DEFAULT_PSRAM_CLK_IO=30
CONFIG_DEFAULT_PSRAM_CS_IO=26

# Optional: Cache configuration for better performance
CONFIG_ESP32S3_DATA_CACHE_SIZE=32768
CONFIG_ESP32S3_DATA_CACHE_LINE_32B=y

# NVS in internal RAM (recommended)
# CONFIG_NVS_ALLOCATE_CACHE_IN_SPIRAM is not set
```
